## main/Kconfig.projbuild
```kconfig
menu "NCLite CLEV4"

    menu "WM (Weighing Machine) UART"
        config NCLE_WM_ENABLE
            bool "Enable WM Module"
            default y
            help
                Enable Weighing Machine UART module.
                Disable to exclude WM functionality from the build.

        config NCLE_WM_USE_SOFT_UART
            bool "Use RMT-based software UART for WM (frees a hardware UART for GSM)"
            default y
            depends on NCLE_WM_ENABLE
            help
                When enabled (recommended), WM data is received via the RMT-based
                software UART driver (components/soft_uart_rmt) on the GPIO
                configured by NCLE_WM_UART_RX_PIN. This frees a hardware UART
                controller for the GSM module. When disabled, WM uses the
                hardware UART selected by NCLE_WM_UART_NUM.

        config NCLE_WM_UART_NUM
            int "WM Hardware UART Port Number (0, 1, or 2)"
            default 0
            range 0 2
            depends on NCLE_WM_ENABLE
            help
                Hardware UART controller for WM. Only used when
                NCLE_WM_USE_SOFT_UART is disabled. Soft UART (recommended)
                does not use any hardware UART controller.

        config NCLE_WM_UART_TX_ENABLE
            bool "Enable WM UART TX Pin"
            default n
            depends on NCLE_WM_ENABLE
            help
                Enable TX pin for WM hardware UART. Disable if only receiving
                data from weighing machine (prevents garbage output on TX).
                Only relevant when soft UART is disabled (soft UART is RX-only).

        config NCLE_WM_UART_TX_PIN
            int "WM UART TX GPIO"
            default 43
            range 0 48
            depends on NCLE_WM_UART_TX_ENABLE
            help
                GPIO pin for WM hardware UART TX.

        config NCLE_WM_UART_RX_PIN
            int "WM UART RX GPIO (used by both hard and soft UART paths)"
            default 44
            range 0 48
            depends on NCLE_WM_ENABLE
            help
                GPIO pin for WM RX. The same pin is used regardless of
                whether soft UART or hardware UART path is selected.

        config NCLE_WM_UART_BAUD_RATE
            int "WM UART Baud Rate"
            default 9600
            depends on NCLE_WM_ENABLE
            help
                Baud rate for WM serial communication.

        config NCLE_WM_UART_BUF_SIZE
            int "WM Hardware UART Buffer Size"
            default 256
            range 128 1024
            depends on NCLE_WM_ENABLE
            help
                Buffer size for WM hardware UART RX/TX. Only used when
                NCLE_WM_USE_SOFT_UART is disabled.
    endmenu

    menu "MA (Milk Analyzer) UART"
        config NCLE_MA_ENABLE
            bool "Enable MA Module"
            default y
            help
                Enable Milk Analyzer UART module.
                Disable to exclude MA functionality from the build.

        config NCLE_MA_UART_NUM
            int "MA UART Port Number (0, 1, or 2)"
            default 2
            range 0 2
            depends on NCLE_MA_ENABLE
            help
                UART port number for Milk Analyzer.
                Default: UART2

        config NCLE_MA_UART_TX_PIN
            int "MA UART TX GPIO"
            default 40
            range 0 48
            depends on NCLE_MA_ENABLE
            help
                GPIO pin for MA UART TX.
                Default: GPIO40 (U2TX_MA in schematic)

        config NCLE_MA_UART_RX_PIN
            int "MA UART RX GPIO"
            default 39
            range 0 48
            depends on NCLE_MA_ENABLE
            help
                GPIO pin for MA UART RX.
                Default: GPIO39 (U2RX_MA in schematic)

        config NCLE_MA_UART_BAUD_RATE
            int "MA UART Default Baud Rate"
            default 9600
            depends on NCLE_MA_ENABLE
            help
                Default baud rate for MA UART (configurable via menuconfig or JSON command)

        config NCLE_MA_UART_BUF_SIZE
            int "MA UART Buffer Size"
            default 1024
            range 256 2048
            depends on NCLE_MA_ENABLE
            help
                Buffer size for MA UART RX/TX.
                MA data packets can be larger than WM.
    endmenu

    menu "Printer UART"
        config NCLE_PRINTER_ENABLE
            bool "Enable Printer Module"
            default y
            help
                Enable Thermal Printer UART module.
                Disable to exclude Printer functionality from the build.

        config NCLE_PRINTER_UART_NUM
            int "Printer UART Port Number (0, 1, or 2)"
            default 1
            range 0 2
            depends on NCLE_PRINTER_ENABLE
            help
                UART port number for Thermal Printer.
                Default: UART1

        config NCLE_PRINTER_UART_TX_PIN
            int "Printer UART TX GPIO"
            default 17
            range 0 48
            depends on NCLE_PRINTER_ENABLE
            help
                GPIO pin for Printer UART TX (data to printer).
                Default: GPIO17

        config NCLE_PRINTER_UART_RX_PIN
            int "Printer UART RX GPIO"
            default 18
            range 0 48
            depends on NCLE_PRINTER_ENABLE
            help
                GPIO pin for Printer UART RX (status from printer).
                Default: GPIO18

        config NCLE_PRINTER_UART_BAUD_RATE
            int "Printer UART Default Baud Rate"
            default 9600
            depends on NCLE_PRINTER_ENABLE
            help
                Default baud rate for Printer UART.

        config NCLE_PRINTER_UART_BUF_SIZE
            int "Printer UART Buffer Size"
            default 256
            range 128 512
            depends on NCLE_PRINTER_ENABLE
            help
                Buffer size for Printer UART RX/TX.

        config NCLE_PRINTER_RECEIPT_BUF_SIZE
            int "Receipt Storage Buffer Size"
            default 2048
            range 1024 4096
            depends on NCLE_PRINTER_ENABLE
            help
                Buffer size for storing receipt data (for reprint).
    endmenu

    menu "Status LED"
        config NCLE_STATUS_LED_GPIO
            int "Status LED GPIO Pin"
            default 36
            range 0 48
            help
                GPIO pin for the status/activity LED.
                Default: GPIO36 (active_led in schematic)

        config NCLE_STATUS_LED_ACTIVE_HIGH
            bool "LED Active High"
            default y
            help
                If enabled, LED turns ON when GPIO is HIGH.
                If disabled, LED turns ON when GPIO is LOW (inverted).
    endmenu

    menu "Battery Monitor"
        config NCLE_BATTERY_ENABLE
            bool "Enable Battery Monitor"
            default y
            help
                Enable battery voltage monitoring via ADC.
                Disable to exclude battery monitoring from the build.

        config NCLE_BATTERY_ADC_GPIO
            int "Battery ADC GPIO Pin"
            default 6
            range 1 10
            depends on NCLE_BATTERY_ENABLE
            help
                GPIO pin for battery voltage ADC input.
                ESP32-S3 ADC1: GPIO1-10 (ADC1_CH0-9)
                Default: GPIO6 (ADC1_CH5)

        config NCLE_BATTERY_DIVIDER_RATIO
            int "Voltage Divider Ratio (x100)"
            default 200
            range 100 1000
            depends on NCLE_BATTERY_ENABLE
            help
                Voltage divider ratio multiplied by 100.
                Example: For 100K/100K divider (2:1 ratio), enter 200.
                Example: For 200K/100K divider (3:1 ratio), enter 300.
                Default: 200 (2:1 ratio)

        config NCLE_BATTERY_FULL_MV
            int "Battery Full Voltage (mV)"
            default 4200
            range 3000 10000
            depends on NCLE_BATTERY_ENABLE
            help
                Battery voltage at 100% charge (in millivolts).
                Default: 4200 (single Li-Ion cell)

        config NCLE_BATTERY_EMPTY_MV
            int "Battery Empty Voltage (mV)"
            default 3000
            range 2500 8000
            depends on NCLE_BATTERY_ENABLE
            help
                Battery voltage at 0% charge (in millivolts).
                Default: 3000 (single Li-Ion cell cutoff)
    endmenu

    menu "Development: Soft UART Smoke Test"
        config NCLE_SOFT_UART_LOOPBACK_TEST
            bool "Enable soft UART GPIO loopback smoke test"
            default n
            help
                When enabled, main.c runs a one-shot test that bit-bangs
                the ASCII string "HELLO\n" on the TX GPIO and verifies that
                soft_uart_rmt receives it on the RX GPIO. Requires a jumper
                wire between TX and RX GPIOs. Disable for production.

        config NCLE_SOFT_UART_LOOPBACK_TX_GPIO
            int "Loopback TX GPIO"
            default 15
            depends on NCLE_SOFT_UART_LOOPBACK_TEST

        config NCLE_SOFT_UART_LOOPBACK_RX_GPIO
            int "Loopback RX GPIO"
            default 44
            depends on NCLE_SOFT_UART_LOOPBACK_TEST
    endmenu

    menu "OTA Update"
        config NCLE_OTA_ENABLE
            bool "Enable OTA Updates"
            default y
            help
                Enable Over-The-Air firmware updates via BLE.
                Requires OTA partition table (partitions.csv with ota_0, ota_1).

        config NCLE_OTA_ROLLBACK_ENABLE
            bool "Enable Automatic Rollback"
            default y
            depends on NCLE_OTA_ENABLE
            help
                Enable automatic rollback to previous firmware if new
                firmware fails to boot properly.
    endmenu

    menu "GSM Module (EC200U-CN)"
        config NCLE_GSM_ENABLE
            bool "Enable GSM Module"
            default n
            help
                Enable GSM/LTE module support (Quectel EC200U-CN).
                Requires hardware UART0 to be free - WM must be on soft UART
                (CONFIG_NCLE_WM_USE_SOFT_UART=y).

        config NCLE_GSM_AUTO_START
            bool "Start GSM automatically at boot"
            default y
            depends on NCLE_GSM_ENABLE
            help
                When enabled, gsm_task starts during boot and brings the data
                link up without waiting for the BLE/USB "gsm_enable" command.
                Required for a field device: nobody is present to send
                commands to a machine at a collection centre.

                The task retries with back-off if the modem is missing or slow
                to power up, so enabling this is safe even when the modem
                boots after the ESP32.

                Disable to keep the old behaviour (wait for gsm_enable), which
                is useful while bench-testing a change and you want to trigger
                the connection deliberately and watch it.

        config NCLE_GSM_UART_NUM
            int "GSM UART Port Number (0, 1, or 2)"
            default 0
            range 0 2
            depends on NCLE_GSM_ENABLE
            help
                UART controller for GSM module.
                Default: UART0 (freed when WM uses soft UART).

        config NCLE_GSM_UART_TX_PIN
            int "GSM UART TX GPIO (ESP TX -> Module RX)"
            default 16
            range 0 48
            depends on NCLE_GSM_ENABLE
            help
                GPIO pin for GSM UART TX. Default: GPIO16.

        config NCLE_GSM_UART_RX_PIN
            int "GSM UART RX GPIO (ESP RX <- Module TX)"
            default 15
            range 0 48
            depends on NCLE_GSM_ENABLE
            help
                GPIO pin for GSM UART RX. Default: GPIO15.

        config NCLE_GSM_PWRKEY_PIN
            int "GSM PWRKEY GPIO"
            default 7
            range 0 48
            depends on NCLE_GSM_ENABLE
            help
                GPIO pin for GSM module PWRKEY (power on/off control).

        config NCLE_GSM_RST_PIN
            int "GSM RESET GPIO"
            default 8
            range 0 48
            depends on NCLE_GSM_ENABLE
            help
                GPIO pin for GSM module hardware RESET.

        config NCLE_GSM_RST_INVERTED
            bool "Inverted RESET polarity (HIGH = assert)"
            default y
            depends on NCLE_GSM_ENABLE
            help
                Default (on) matches the Conn_plus board design which uses
                an inverter on the RESET line: HIGH = assert reset,
                LOW = release reset.
                Disable only if your CLv4 board is wired directly to the
                EC200U RESET pin per datasheet (LOW = assert, HIGH idle).

        config NCLE_GSM_UART_BAUD_RATE
            int "GSM UART baud rate"
            default 115200
            depends on NCLE_GSM_ENABLE
            help
                Baud rate for AT command communication. EC200U default 115200.

        config NCLE_GSM_TASK_POLL_INTERVAL_MS
            int "Status poll interval (ms)"
            default 10000
            range 1000 60000
            depends on NCLE_GSM_ENABLE
            help
                How often gsm_task checks alive/signal/network and fires the
                status callback. Default: 10000 (10s).

        config NCLE_GSM_APN
            string "GSM APN (carrier-specific)"
            default "airtelgprs.com"
            depends on NCLE_GSM_ENABLE
            help
                Access Point Name for the SIM card carrier.
                Common APNs (India):
                - Airtel:    "airtelgprs.com"
                - Jio:       "jionet"
                - Vodafone:  "www"
                - BSNL:      "bsnlnet"
                Without correct APN, no data session can be established.

        config NCLE_GSM_LEGACY_AT_HTTP
            bool "Keep the legacy AT-command HTTP/ping path (AT+QHTTP, AT+QPING)"
            default n
            depends on NCLE_GSM_ENABLE
            help
                SUPERSEDED by the PPP path (esp_modem + esp_netif). Leave this
                DISABLED unless you are A/B comparing the two.

                The legacy helpers drive the modem with raw uart_write_bytes()/
                uart_read_bytes(), because the QHTTPURL/QHTTPPOST flow needs a
                CONNECT prompt followed by raw payload bytes. esp_modem now owns
                that UART, so enabling this puts two readers on one RX FIFO: the
                HTTP helper steals PPP frames and PPP steals the modem's replies.
                The corruption is intermittent and does NOT fail the build.

                With PPP up, use esp_http_client for HTTP and the lwIP ping
                instead - that is the whole point of the port.

        config NCLE_GSM_HTTP_INSECURE
            bool "Skip TLS certificate verification (HTTPS insecure mode)"
            default y
            depends on NCLE_GSM_LEGACY_AT_HTTP
            help
                When enabled (default), HTTPS connections skip server
                certificate verification (seclevel=0). Useful for testing
                without uploading CA certs to the modem.
                For PRODUCTION: disable this and provide proper CA cert.
    endmenu

    # Application layer config lives in the component itself, nested here so the
    # whole product presents one clean menu. Path is relative to THIS file -
    # getting it wrong is what broke the WiFi build during its own restructure.
    rsource "../components/application/mqtt_client_svc/Kconfig.in"

endmenu
```
