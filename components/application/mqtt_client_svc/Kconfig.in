## components/application/mqtt_client_svc/Kconfig.in
```kconfig
menu "MQTT"

    config NCLE_MQTT_ENABLE
        bool "Enable MQTT cloud connectivity"
        default n
        help
            Publish milk readings and receive commands over MQTT.
            When disabled, the firmware behaves identically to the
            non-MQTT build.

    config NCLE_MQTT_BROKER_URI
        string "MQTT broker URI"
        depends on NCLE_MQTT_ENABLE
        default "mqtt://broker.hivemq.com:1883"
        help
            Broker URI. Dev: mqtt://broker.hivemq.com:1883 (plain).
            Production later: mqtts://<server>:8883 (TLS) via a config change.

    config NCLE_MQTT_USERNAME
        string "MQTT username (empty = anonymous)"
        depends on NCLE_MQTT_ENABLE
        default ""
        help
            Username for brokers that require authentication (HiveMQ Cloud,
            the production server). Leave EMPTY for anonymous brokers such as
            the public test broker - the credentials are then not sent at all.

    config NCLE_MQTT_PASSWORD
        string "MQTT password"
        depends on NCLE_MQTT_ENABLE
        default ""
        help
            Password paired with NCLE_MQTT_USERNAME. Ignored when the username
            is empty. NOTE: this ends up in sdkconfig - do not commit a real
            production password to the repository.

    config NCLE_MQTT_RESTRICT_RISKY_CMDS
        bool "Block risky commands over MQTT (wifi_config/wifi_erase/reset_config)"
        depends on NCLE_MQTT_ENABLE
        default y
        help
            When enabled (default), wifi_config, wifi_erase and reset_config
            are REJECTED if received over MQTT (cloud) - they can cut the
            device off its network or wipe its setup, so they are allowed only
            over BLE / USB console (on-site). Disable to permit these remotely
            (e.g. for full remote management once the internal server is trusted).

    config NCLE_MQTT_STORE_FORWARD
        bool "Store-and-forward: buffer readings offline (LittleFS)"
        depends on NCLE_MQTT_ENABLE
        default y
        help
            When enabled (default), readings that occur while the broker is
            unreachable are saved to the `storage` flash partition (LittleFS)
            and flushed to the cloud on reconnect (oldest-first, deleted only
            after the broker ACKs). Survives power-off. When disabled, offline
            readings are dropped (BLE/console still deliver them).

endmenu
```

## components/base/soft_uart_rmt/Kconfig.projbuild
```kconfig
menu "Soft UART (RMT-based)"

    config SOFT_UART_RMT_LOG_LEVEL
        int "Soft UART RMT log level (0=none,1=err,2=warn,3=info,4=debug,5=verbose)"
        default 3
        range 0 5
        help
            Verbosity for soft_uart_rmt component.

    config SOFT_UART_RMT_DEFAULT_RESOLUTION_HZ
        int "Default RMT resolution (Hz) for soft UART"
        default 1000000
        range 100000 10000000
        help
            RMT tick resolution. Must be > 16 * max baud rate for good sampling.
            1 MHz (default) gives 1 us ticks, adequate up to ~115200 baud.

    config SOFT_UART_RMT_DEFAULT_SYMBOL_MEM_WORDS
        int "Default RMT symbol memory size (words)"
        default 128
        range 48 256
        help
            RMT receive buffer in 32-bit symbol words. Larger = more tolerant
            to decoder task scheduling latency under load.

endmenu
```

## components/base/wm_uart_validator/Kconfig.projbuild
```kconfig
menu "WM UART Validator (Phase 1 only)"

    config NCLE_WM_VALIDATOR_ENABLE
        bool "Enable WM UART Validator"
        default n
        depends on NCLE_WM_ENABLE
        help
            Phase 1 validation harness. Runs the RMT-based soft UART in
            parallel with the hardware WM UART on the same GPIO and
            compares byte streams. Disable for production.

    config NCLE_WM_VALIDATOR_RMT_CHANNEL
        int "RMT channel for soft UART"
        default 0
        range 0 3
        depends on NCLE_WM_VALIDATOR_ENABLE

    config NCLE_WM_VALIDATOR_REPORT_INTERVAL_MS
        int "Stats report interval (ms)"
        default 10000
        range 1000 60000
        depends on NCLE_WM_VALIDATOR_ENABLE

    config NCLE_WM_VALIDATOR_PACKET_QUIET_MS
        int "Packet end quiet-time (ms)"
        default 50
        range 10 500
        depends on NCLE_WM_VALIDATOR_ENABLE

    config NCLE_WM_VALIDATOR_RUN_SWEEP
        bool "Run baud sweep on boot (Phase 1.5)"
        default n
        depends on NCLE_WM_VALIDATOR_ENABLE

    config NCLE_WM_VALIDATOR_SWEEP_SECONDS_PER_STEP
        int "Seconds per sweep step"
        default 600
        range 30 3600
        depends on NCLE_WM_VALIDATOR_RUN_SWEEP
endmenu
```

## components/ble_spp/Kconfig
```kconfig
menu "BLE SPP Configuration"

    config BLE_SPP_ENABLED
        bool "Enable BLE SPP"
        default y
        help
            Enable BLE Serial Port Profile using Nordic UART Service.
            This allows communication with mobile apps like "Serial Bluetooth Terminal".

endmenu
```

## components/connectivity/wifi_sta/Kconfig.in
```kconfig
menu "WiFi (STA)"

    config NCLE_WIFI_ENABLE
        bool "Enable WiFi STA"
        default n
        help
            Enable WiFi station mode with BLE-based provisioning.
            When disabled, the firmware behaves identically to the
            non-WiFi build.

    config NCLE_WIFI_DEV_CREDENTIALS
        bool "Use developer default WiFi credentials (bench testing)"
        depends on NCLE_WIFI_ENABLE
        default n
        help
            When enabled and no credentials are stored in NVS, the device
            auto-connects using the SSID/password below. Disable in production.

    config NCLE_WIFI_DEV_SSID
        string "Developer WiFi SSID"
        depends on NCLE_WIFI_DEV_CREDENTIALS
        default "MyTestAP"

    config NCLE_WIFI_DEV_PASSWORD
        string "Developer WiFi password"
        depends on NCLE_WIFI_DEV_CREDENTIALS
        default "password123"

endmenu
```
